## boards/arm/coffeecaller_nrf52/coffeecaller_nrf52_nrf52840_defconfig
```kconfig
# Copyright (c) 2025 TiaC Systems
# SPDX-License-Identifier: Apache-2.0

# No external 32 kHz crystal present
CONFIG_NRFX_CLOCK_LFXO_TWO_STAGE_ENABLED=n
CONFIG_CLOCK_CONTROL_NRF_K32SRC_RC=y

# Enable MPU
CONFIG_ARM_MPU=y

# Enable hardware stack protection
CONFIG_HW_STACK_PROTECTION=y

# Enable RTT
CONFIG_USE_SEGGER_RTT=y

# Enable console via USB CDC-ACM
CONFIG_CONSOLE=y
CONFIG_SERIAL=y
CONFIG_UART_CONSOLE=y
CONFIG_UART_LINE_CTRL=y
CONFIG_UART_INTERRUPT_DRIVEN=y

# USB configuration
CONFIG_USB_DEVICE_STACK=y
CONFIG_USB_DEVICE_VID=0x1915
CONFIG_USB_DEVICE_PID=0xC0CA
CONFIG_USB_DEVICE_MANUFACTURER="TiaC (Nordic Semiconductor ASA)"
CONFIG_USB_DEVICE_PRODUCT="CoffeeCaller nRF52 (CDC ACM)"
CONFIG_USB_DEVICE_INITIALIZE_AT_BOOT=y
```
