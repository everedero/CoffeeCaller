## CMakeLists.txt
```
# SPDX-FileCopyrightText: 2025 Alicipy <dev@stefankraus.org>
#
# SPDX-License-Identifier: Apache-2.0

cmake_minimum_required(VERSION 3.20.0)
find_package(Zephyr REQUIRED HINTS $ENV{ZEPHYR_BASE})
project(zigbee_temp)

target_sources(app PRIVATE src/main.c src/ventilation.c)
```

## prj.conf
```kconfig
# SPDX-License-Identifier: Apache-2.0

CONFIG_NCS_SAMPLES_DEFAULTS=y

# Disable CoffeeCaller subsystems (not needed; cc_broadcast defaults to OpenThread
# on hardware, which conflicts with the Zigbee IEEE 802.15.4 radio)
CONFIG_CC_BROADCAST_SUBSYS=n
CONFIG_CC_COFFEECALL_SUBSYS=n
CONFIG_CC_TEMPERATURE_SUBSYS=n
CONFIG_TRANSPORT_LOCALQUEUE=y

CONFIG_UART_INTERRUPT_DRIVEN=y
CONFIG_SERIAL=y
CONFIG_GPIO=y
CONFIG_CONSOLE=y
CONFIG_UART_CONSOLE=y
CONFIG_HEAP_MEM_POOL_SIZE=8192
CONFIG_MAIN_THREAD_PRIORITY=7
CONFIG_SYSTEM_WORKQUEUE_STACK_SIZE=2048

# Zigbee coordinator
CONFIG_ZIGBEE=y
CONFIG_ZIGBEE_APP_UTILS=y
CONFIG_ZIGBEE_ROLE_COORDINATOR=y
CONFIG_DK_LIBRARY=y

# BLE peripheral (ESS) — MPSL handles radio time-sharing automatically
# Use ocrypto software AES for ZBOSS: bt_encrypt_be() (the BT_CTLR path) uses
# big-endian byte-swapped AES which breaks Zigbee network key transport.
# The nRF ECB Zephyr driver conflicts with BLE's SoftDevice ECB usage.
# Software AES (ocrypto) is the correct safe path when BLE + Zigbee coexist.
CONFIG_CRYPTO=n
CONFIG_CRYPTO_NRF_ECB=n
CONFIG_ZIGBEE_USE_SOFTWARE_AES=y
CONFIG_BT=y
CONFIG_BT_PERIPHERAL=y
CONFIG_BT_DEVICE_NAME="CoffeeCaller"
CONFIG_BT_DEVICE_APPEARANCE=1344
CONFIG_BT_MAX_CONN=4

# Disable unused IP networking (Zigbee uses its own L2)
CONFIG_NET_IPV6=n
CONFIG_NET_IP_ADDR_CHECK=n
CONFIG_NET_UDP=n

# Ventilation alarm
CONFIG_PWM=y
CONFIG_LED_STRIP=y

# Logging
CONFIG_LOG=y
CONFIG_LOG_DEFAULT_LEVEL=3
CONFIG_CBPRINTF_FP_SUPPORT=y
```

## boards/coffeecaller_nrf52_nrf52840.conf
```kconfig
# SPDX-FileCopyrightText: 2025 Alicipy <dev@stefankraus.org>
#
# SPDX-License-Identifier: Apache-2.0

# CoffeeCaller uses USB CDC-ACM for the console; override the UART-only defaults
# from prj.conf so serial output reaches the host over USB.
CONFIG_USB_CDC_ACM=y
CONFIG_UART_LINE_CTRL=y
```

## src/ventilation.c
```c
/*
 * SPDX-License-Identifier: Apache-2.0
 *
 * Temperature sensor and ventilation alarm
 */

#include "ventilation.h"
#include <zephyr/kernel.h>
#include <zephyr/logging/log.h>
#include <zephyr/drivers/pwm.h>
#include <zephyr/drivers/led_strip.h>

LOG_MODULE_REGISTER(ventilation, LOG_LEVEL_INF);

static const struct device *pwm0_dev;
static const struct device *strip_dev;

/* Choose the buzzer freq */
#define BUZZER_FREQ_HZ  880U
#define BUZZER_PERIOD_NS (NSEC_PER_SEC / BUZZER_FREQ_HZ)
/* Total duration of one alarm/test buzz, played as the beep-beep pattern below */
#define VENT_BUZZ_DURATION_MS 10000
#define VENT_BEEP_ON_MS     200
#define VENT_BEEP_OFF_MS    200

#define STRIP_NUM_LEDS  4

static struct led_rgb pixels[STRIP_NUM_LEDS];
/*
 * Creating a mutex to guard pixels[] and led_strip_update_rgb().
 * Two concurrent thread use the GPIO transmission: system workqueue for button
 * press, and Zigbee thread for led_set_outside_indicator.
 * GPIO transmissions on the same wire corrupt each other's pixel data.
 */
static K_MUTEX_DEFINE(led_lock);

static K_MUTEX_DEFINE(v_lock);
static int16_t v_temp[VENT_ROLE_COUNT];           /* centidegrees, indexed by enum vent_role */
static bool  v_temp_valid[VENT_ROLE_COUNT];       /* true once the slot has received at least one report */
static int64_t v_temp_last_seen_ms[VENT_ROLE_COUNT]; /* uptime of the slot's last report */

#define SAMPLE_PERIOD_S 60           /* Sample every minute */
#define HISTORY_SIZE 5              /* 5 samples x 60 s = 5-minute rolling window */
#define SNOOZE_TIME 3600000LL       /* Re-buzz after SNOOZE_TIME, in ms */

#define INSIDE_TEMP_THRESHOLD 2000   /* Minimum temperature at which to run alarm (deg x 100) */
#define MIN_TEMP_DIFF         20    /* Minimum temperature difference (deg x 100) */

/* Sensor considered missing/stale if silent longer than this
 * LED1 blinks if a sensor error is detected
 */
#define SENSOR_STALE_TIMEOUT_MS (10 * 60 * 1000)

static int16_t diff_hist[HISTORY_SIZE];
static int   hist_idx;
static int   hist_count;

static bool  buzz_enabled = true;   /* Armed at boot; button 1 toggles to disarm */
/* Negative initial value ensures cooldown is not active at first trigger */
static int64_t last_buzz_uptime_ms = -3600000LL;

static struct k_timer        sample_timer;
static struct k_work         sample_work;
static struct k_work_delayable buzz_pattern_work;

static int64_t buzz_pattern_deadline_ms;
static bool  buzz_pattern_on;

static void buzzer_set(bool on)
{
	pwm_set(pwm0_dev, 0, BUZZER_PERIOD_NS, on ? BUZZER_PERIOD_NS / 2 : 0,
		PWM_POLARITY_NORMAL);
}

static void buzz_pattern_work_fn(struct k_work *w)
{
	ARG_UNUSED(w);

	if (k_uptime_get() >= buzz_pattern_deadline_ms) {
		buzzer_set(false);
		LOG_INF("Buzzer pattern done");
		return;
	}

	buzz_pattern_on = !buzz_pattern_on;
	buzzer_set(buzz_pattern_on);
	k_work_schedule(&buzz_pattern_work,
			K_MSEC(buzz_pattern_on ? VENT_BEEP_ON_MS : VENT_BEEP_OFF_MS));
}

static void buzzer_start_pattern(uint32_t duration_ms)
{
	buzz_pattern_deadline_ms = k_uptime_get() + duration_ms;
	buzz_pattern_on = true;
	buzzer_set(true);
	k_work_schedule(&buzz_pattern_work, K_MSEC(VENT_BEEP_ON_MS));
}

/*
 * LED strip first LED is only on when the buzzer is active.
 * LED second LED is active as soon as both sensors are detected, and
 * tells if temperature is hotter and fresher outside.
 * We store state to update all the LEDs from the LED strip at the same time.
 */
static struct led_rgb buzz_en_color;
static struct led_rgb outside_color;

static void leds_update(void)
{
	k_mutex_lock(&led_lock, K_FOREVER);
	pixels[0] = buzz_en_color;
	pixels[1] = outside_color;
	led_strip_update_rgb(strip_dev, pixels, STRIP_NUM_LEDS);
	k_mutex_unlock(&led_lock);
}

static void led_set_buzzer(bool enabled)
{
	buzz_en_color = enabled ? (struct led_rgb){.r = 128, .g = 0, .b = 0}
			   : (struct led_rgb){.r = 0, .g = 0, .b = 0};
	leds_update();
}

static void led_set_outside_indicator(int16_t inside, int16_t outside)
{
	outside_color = (outside <= inside)
				? (struct led_rgb){.r = 0, .g = 0, .b = 128} /* blue: fresher outside */
				: (struct led_rgb){.r = 160, .g = 60, .b = 0}; /* orange: hotter outside */
	leds_update();
}

static void sample_work_fn(struct k_work *w)
{
	ARG_UNUSED(w);

	int16_t inside, outside;
	bool both_valid;

	k_mutex_lock(&v_lock, K_FOREVER);
	inside   = v_temp[VENT_ROLE_INSIDE];
	outside  = v_temp[VENT_ROLE_OUTSIDE];
	both_valid = v_temp_valid[VENT_ROLE_INSIDE] && v_temp_valid[VENT_ROLE_OUTSIDE];
	k_mutex_unlock(&v_lock);

	if (!both_valid) {
		LOG_INF("vent: waiting for both sensors");
		return;
	}

	int16_t diff = inside - outside;

	diff_hist[hist_idx] = diff;
	hist_idx = (hist_idx + 1) % HISTORY_SIZE;
	if (hist_count < HISTORY_SIZE) {
		hist_count++;
	}

	int32_t sum = 0;

	for (int i = 0; i < hist_count; i++) {
		sum += diff_hist[i];
	}
	int16_t avg_diff = (int16_t)(sum / hist_count);

	LOG_INF("vent_sample: inside=%d outside=%d diff=%d avg=%d (n=%d/%d)",
		inside, outside, diff, avg_diff, hist_count, HISTORY_SIZE);

	if (!buzz_enabled) {
		return;
	}
	if (hist_count < HISTORY_SIZE) {
		LOG_INF("vent: warming up, waiting for full window");
		return;
	}
	if (inside <= INSIDE_TEMP_THRESHOLD) {
		LOG_INF("vent: no buzz - inside %d <= threshold %d",
			inside, INSIDE_TEMP_THRESHOLD);
		return; /* inside not warm enough */
	}
	if (avg_diff <= MIN_TEMP_DIFF) {
		LOG_INF("vent: no buzz - avg_diff %d <= min %d",
			avg_diff, MIN_TEMP_DIFF);
		return; /* not enough gradient */
	}
	if (k_uptime_get() - last_buzz_uptime_ms < SNOOZE_TIME) {
		LOG_INF("vent: cooldown active");
		return;
	}

	LOG_INF("vent: BUZZ triggered (inside=%d avg_diff=%d)", inside, avg_diff);
	last_buzz_uptime_ms = k_uptime_get();
	buzzer_start_pattern(VENT_BUZZ_DURATION_MS);
}

static void sample_timer_fn(struct k_timer *t)
{
	ARG_UNUSED(t);
	k_work_submit(&sample_work);
}

/* Public API */

void ventilation_init(void)
{
	pwm0_dev= DEVICE_DT_GET(DT_NODELABEL(pwm0));
	strip_dev = DEVICE_DT_GET(DT_ALIAS(led_strip));

	if (!device_is_ready(pwm0_dev)) {
		LOG_ERR("PWM0 not ready");
	}
	if (!device_is_ready(strip_dev)) {
		LOG_ERR("LED strip not ready");
	}

	k_work_init(&sample_work, sample_work_fn);
	k_work_init_delayable(&buzz_pattern_work, buzz_pattern_work_fn);
	k_timer_init(&sample_timer, sample_timer_fn, NULL);
	k_timer_start(&sample_timer,
		    K_SECONDS(SAMPLE_PERIOD_S), K_SECONDS(SAMPLE_PERIOD_S));

	led_set_buzzer(buzz_enabled);

	LOG_INF("Ventilation alarm initialized (%s; %d-min warmup)",
		buzz_enabled ? "armed" : "disarmed", HISTORY_SIZE);
}

void ventilation_update_temp(int slot, int16_t temp_centideg)
{
	if (slot < 0 || slot >= VENT_ROLE_COUNT) {
		return;
	}
	k_mutex_lock(&v_lock, K_FOREVER);
	v_temp[slot]            = temp_centideg;
	v_temp_valid[slot]      = true;
	v_temp_last_seen_ms[slot] = k_uptime_get();

	bool  both_valid = v_temp_valid[VENT_ROLE_INSIDE] && v_temp_valid[VENT_ROLE_OUTSIDE];
	int16_t inside   = v_temp[VENT_ROLE_INSIDE];
	int16_t outside  = v_temp[VENT_ROLE_OUTSIDE];
	k_mutex_unlock(&v_lock);

	if (both_valid) {
		led_set_outside_indicator(inside, outside);
	}
}

bool ventilation_sensor_missing(void)
{
	bool  missing;
	int64_t now = k_uptime_get();

	k_mutex_lock(&v_lock, K_FOREVER);
	missing = !v_temp_valid[VENT_ROLE_INSIDE] || !v_temp_valid[VENT_ROLE_OUTSIDE] ||
		(now - v_temp_last_seen_ms[VENT_ROLE_INSIDE]) > SENSOR_STALE_TIMEOUT_MS ||
		(now - v_temp_last_seen_ms[VENT_ROLE_OUTSIDE]) > SENSOR_STALE_TIMEOUT_MS;
	k_mutex_unlock(&v_lock);

	return missing;
}

void vent_buzzer_toggle(void)
{
	buzz_enabled = !buzz_enabled;
	led_set_buzzer(buzz_enabled);
	LOG_INF("Ventilation alarm %s", buzz_enabled ? "ENABLED" : "DISABLED");
}

bool vent_buzzer_is_enabled(void)
{
	return buzz_enabled;
}

void ventilation_buzz_test(void)
{
	LOG_INF("Buzzer test");
	buzzer_start_pattern(1000);
}
```

## src/ventilation.h
```c
/*
 * SPDX-License-Identifier: Apache-2.0
 */

#pragma once
#include <stdbool.h>
#include <stdint.h>

/* Shared inside/outside slot convention, used by both main.c (Zigbee sensor
 * slot assignment) and ventilation.c (temperature roles). */
enum vent_role {
	VENT_ROLE_INSIDE = 0,
	VENT_ROLE_OUTSIDE = 1,
	VENT_ROLE_COUNT,
};

/* Call once from main() after hardware init */
void ventilation_init(void);

/* Call from zcl_ep_handler when a temperature report arrives */
void ventilation_update_temp(int slot, int16_t temp_centideg);

/* Toggle the ventilation alarm on/off (call from button handler) */
void vent_buzzer_toggle(void);

/* Fire the buzzer immediately for 1 s — hardware test */
void ventilation_buzz_test(void);

bool vent_buzzer_is_enabled(void);

/* True if the inside or outside sensor hasn't reported recently */
bool ventilation_sensor_missing(void);
```
